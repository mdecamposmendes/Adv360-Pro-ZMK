#define VERSION_MACRO
macro_ver: macro_ver {
compatible = "zmk,behavior-macro";
label = "macro_ver";
#binding-cells = <0>;
bindings = <&kp N2>, <&kp N0>, <&kp N2>, <&kp N6>, <&kp N0>, <&kp N2>, <&kp N1>, <&kp N8>, <&kp MINUS>, <&kp V>, <&kp N3>, <&kp DOT>, <&kp N0>, <&kp MINUS>, <&kp A>, <&kp A>, <&kp N8>, <&kp F>, <&kp N9>, <&kp E>, <&kp C>, <&kp RET>;
};
